## configs/rpi_5_defconfig
```kconfig
CONFIG_ARM=y
CONFIG_POSITION_INDEPENDENT=y
CONFIG_ARCH_BCM283X=y
CONFIG_BCM2712=y
CONFIG_TARGET_RPI_ARM64=y
CONFIG_ENV_SIZE=0x4000
CONFIG_DEFAULT_DEVICE_TREE="bcm2711-rpi-4-b"
CONFIG_OF_LIBFDT_OVERLAY=y
CONFIG_DM_RESET=y
CONFIG_SYS_LOAD_ADDR=0x1000000
CONFIG_PCI=y
CONFIG_BOOTSTD_DEFAULTS=y
CONFIG_OF_BOARD_SETUP=y
CONFIG_FDT_SIMPLEFB=y
CONFIG_USE_PREBOOT=y
CONFIG_PREBOOT=""
CONFIG_SYS_PBSIZE=1049
# CONFIG_DISPLAY_CPUINFO is not set
# CONFIG_DISPLAY_BOARDINFO is not set
CONFIG_MISC_INIT_R=y
CONFIG_SYS_PROMPT="U-Boot> "
CONFIG_CMD_GPIO=y
CONFIG_CMD_MMC=y
CONFIG_CMD_PCI=y
CONFIG_CMD_USB=y
CONFIG_CMD_FS_UUID=y
CONFIG_ENV_FAT_DEVICE_AND_PART="0:1"
CONFIG_ENV_VARS_UBOOT_RUNTIME_CONFIG=y
CONFIG_TFTP_TSIZE=y
CONFIG_DM_DMA=y
CONFIG_BCM2835_GPIO=y
CONFIG_MMC_SDHCI=y
CONFIG_MMC_SDHCI_SDMA=y
CONFIG_MMC_SDHCI_BCM2835=y
CONFIG_MMC_SDHCI_BCMSTB=y
CONFIG_BCMGENET=y
CONFIG_PCI_BRCMSTB=y
CONFIG_PINCTRL=y
# CONFIG_PINCTRL_GENERIC is not set
CONFIG_DM_RNG=y
CONFIG_RNG_IPROC200=y
# CONFIG_REQUIRE_SERIAL_CONSOLE is not set
CONFIG_SYSINFO=y
CONFIG_SYSINFO_SMBIOS=y
CONFIG_USB=y
CONFIG_DM_USB_GADGET=y
CONFIG_USB_XHCI_HCD=y
CONFIG_USB_XHCI_PCI=y
CONFIG_USB_DWC2=y
CONFIG_USB_KEYBOARD=y
CONFIG_USB_HOST_ETHER=y
CONFIG_USB_ETHER_LAN78XX=y
CONFIG_USB_ETHER_SMSC95XX=y
CONFIG_VIDEO=y
# CONFIG_VIDEO_BPP8 is not set
# CONFIG_VIDEO_BPP16 is not set
CONFIG_SYS_WHITE_ON_BLACK=y
CONFIG_VIDEO_BCM2835=y
CONFIG_CONSOLE_SCROLL_LINES=10
CONFIG_PHYS_TO_BUS=y
#
# RP1 Additions
#

CONFIG_RESET_BRCMSTB=y
CONFIG_MFD_RP1=y
CONFIG_PCI_PNP=y
CONFIG_RESET_RASPBERRYPI=y
CONFIG_RESET_BRCMSTB_RESCAL=y
CONFIG_MACB=y
CONFIG_CLK=y
CONFIG_CLK_RP1=y
CONFIG_OF_REAL=y
CONFIG_RP1_GPIO=y
CONFIG_BOARD_LATE_INIT=y
CONFIG_BOARD_TYPES=y

#
# Vispero Additions
#
CONFIG_ANDROID_BOOT_IMAGE=y
CONFIG_CMD_BCB=y
CONFIG_CMD_ABOOTIMG=y
CONFIG_CMD_ADTIMG=y
CONFIG_CMD_GPT=y
CONFIG_CMD_GPT_RENAME=y
CONFIG_CMD_SETEXPR=y
CONFIG_USB_GADGET=y
CONFIG_USB_FUNCTION_FASTBOOT=y
CONFIG_CMD_FASTBOOT=y
CONFIG_FASTBOOT_FLASH=y
CONFIG_FASTBOOT_CMD_OEM_FORMAT=y
CONFIG_FASTBOOT_FLASH_MMC_DEV=0
CONFIG_FASTBOOT_BUF_ADDR=0x3000000
CONFIG_FASTBOOT_BUF_SIZE=0x1000000
CONFIG_CMD_PART=y
CONFIG_LZ4=y
CONFIG_RANDOM_UUID=y
CONFIG_ANDROID_AB=y
CONFIG_CMD_AB_SELECT=y

# Default Fastboot VID and PID
CONFIG_USB_GADGET_VENDOR_NUM=0x18D1
CONFIG_USB_GADGET_PRODUCT_NUM=0x4EE0

# AVB2
CONFIG_LIBAVB=y
CONFIG_AVB_VERIFY=y
CONFIG_CMD_AVB=y
# 128MiB to fit boot partitions + 16MiB for remaining stuff
CONFIG_SYS_MALLOC_LEN=0x9000000
```
